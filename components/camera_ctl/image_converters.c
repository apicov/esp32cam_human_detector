#include "image_converters.h"
#include "esp_log.h"
#include "esp_err.h"
#include "jpeg_decoder.h"

static const char* TAG = "img_conv";

// Working buffer for JPEG decoder (3.1KB as used in ESP32-Camera)
static uint8_t work_buffer[3100];

bool jpeg_to_rgb888(const uint8_t *jpeg_data, size_t jpeg_len, 
                    uint8_t *rgb_buf, uint16_t max_width, uint16_t max_height,
                    uint16_t *actual_width, uint16_t *actual_height) {
    
    if (jpeg_data == NULL || rgb_buf == NULL) {
        ESP_LOGE(TAG, "NULL input parameters");
        return false;
    }
    
    if (jpeg_len == 0) {
        ESP_LOGE(TAG, "Zero JPEG length");
        return false;
    }
    
    // Calculate maximum output buffer size
    uint32_t max_output_size = max_width * max_height * 3; // RGB888 = 3 bytes per pixel
    
    esp_jpeg_image_cfg_t jpeg_cfg = {
        .indata = (uint8_t *)jpeg_data,
        .indata_size = jpeg_len,
        .outbuf = rgb_buf,
        .outbuf_size = max_output_size,
        .out_format = JPEG_IMAGE_FORMAT_RGB888,
        .out_scale = JPEG_IMAGE_SCALE_0,  // No scaling
        .flags.swap_color_bytes = 0,
        .advanced.working_buffer = work_buffer,
        .advanced.working_buffer_size = sizeof(work_buffer),
    };
    
    esp_jpeg_image_output_t output_img = {};
    
    ESP_LOGD(TAG, "Decoding JPEG: %zu bytes -> RGB888", jpeg_len);
    
    esp_err_t ret = esp_jpeg_decode(&jpeg_cfg, &output_img);
    if (ret != ESP_OK) {
        ESP_LOGE(TAG, "JPEG decode failed: %s", esp_err_to_name(ret));
        return false;
    }
    
    // Return actual dimensions
    if (actual_width) {
        *actual_width = output_img.width;
    }
    if (actual_height) {
        *actual_height = output_img.height;
    }
    
    ESP_LOGI(TAG, "JPEG decoded successfully: %dx%d -> RGB888", 
             output_img.width, output_img.height);
    
    return true;
}

// YUV lookup table copied from ESP32-Camera yuv.c
typedef struct {
    int16_t vY;
    int16_t vVr;
    int16_t vVg;
    int16_t vUg;
    int16_t vUb;
} yuv_table_row;

static const yuv_table_row yuv_table[256] = {
    //  Y    Vr    Vg    Ug    Ub     
    {  -18, -204,   50,  104, -258 }, // 0
    {  -17, -202,   49,  103, -256 }, // 1
    {  -16, -201,   49,  102, -254 }, // 2
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    {  275,   200,  -42, -104,  258 }  // 257 (invalid but kept for safety)
};

#define YUYV_CONSTRAIN(v) ((v)<0)?0:(((v)>255)?255:(v))

void yuv2rgb(uint8_t y, uint8_t u, uint8_t v, uint8_t *r, uint8_t *g, uint8_t *b) {
    int16_t ri, gi, bi;

    ri = yuv_table[y].vY + yuv_table[v].vVr;
    gi = yuv_table[y].vY + yuv_table[u].vUg + yuv_table[v].vVg;
    bi = yuv_table[y].vY + yuv_table[u].vUb;

    *r = YUYV_CONSTRAIN(ri);
    *g = YUYV_CONSTRAIN(gi);
    *b = YUYV_CONSTRAIN(bi);
}

void rgb565_to_rgb888(uint16_t rgb565, uint8_t *r, uint8_t *g, uint8_t *b) {
    *r = (rgb565 >> 11) << 3;           // 5 bits -> 8 bits
    *g = ((rgb565 >> 5) & 0x3F) << 2;   // 6 bits -> 8 bits  
    *b = (rgb565 & 0x1F) << 3;          // 5 bits -> 8 bits
}

uint16_t rgb888_to_rgb565(uint8_t r, uint8_t g, uint8_t b) {
    return ((r >> 3) << 11) | ((g >> 2) << 5) | (b >> 3);
}